#include <SoftwareSerial.h> // Подключаем библиотеку для работы 
#include <Servo.h>   // Подключаем библиотеку для сервоприводов


const int TX_BT = 51;
const int RX_BT = 50;
SoftwareSerial BTSerial(51, 50); // RX, TX
// Создаем объект для сервопривода 
Servo vservo;

// Создаем переменную для команд Bluetooth 
char vcmd; 


 void setup() {
 BTSerial.begin(9600); //открывает последовательный порт, устанавливает скорость 9600 бит/c
   // Выбираем пин к которому подключен сервопривод 
  vservo.attach(9); // или 10, если воткнули в крайний разъём 
  // Поворачиваем сервопривод в положение 90 градусов при каждом включении 
  vservo.write(90); 
  }
  
   
void loop() { 
 
   
// Если есть данные 
if (BTSerial.available()) 
{ 
// Читаем команды и заносим их в переменную. char преобразует код символа команды в символ 
vcmd = (char)BTSerial.read(); 
// Отправляем команду в порт, чтобы можно было их проверить в «Мониторе порта» 
Serial.println(vcmd);
// Вперед 
if (vcmd == 'W') { // "W"- ПЕРЕДНИЕ ФОНАРИ , У НАС РУКА РАЗЖИМАЕТ
vFRONT();
}
}
if (vcmd == 'U') { //"U"- ЗАХВАТ
vBACK();
}
}
void vFRONT() {
  vservo.write(90); // Поворот сервы на угол 90 градусов 
 }
 void vBACK() {
  vservo.write(0); // Поворот сервы на угол 0 градусов 
  
  }

